#include <f32c_VGATextConsole.h>
#include <f32c_PS2Keyboard.h>

// CAUTION: The sketch below is a "hack" for testing purposes.  You have been warned. :-)

void drawRLE();

#define FB_WIDTH  640
#define FB_HEIGHT 480

//uint8_t fb[FB_WIDTH * FB_HEIGHT] __attribute__ ((aligned (4)));
uint8_t *fb = (uint8_t) 0x81f00000;

static inline void plot(int x, int y, int color)
{
  uint32_t off = (y * FB_WIDTH) + x;
  if (off < sizeof (fb))
    fb[off] = color;
}

PS2Keyboard keyboard;

void setup() {
  // put your setup code here, to run once:
  vga.Setup();
  vga.SetColor(0x1F);
  vga.Clear();
  vga.DisableTextCursor();
  vga.println("Welcome to f32c_VGAConsoleTest");

  vga.println("\nVGA_textmode Features Configured:\n");

  vga.print("Video Generation:                 ");
  vga.println(vga.IsDisplayConfigured() ? "Yes" : "No");

  vga.print("Screen size:                      ");
  vga.print(vga.GetDisplayWidth());
  vga.print("x");
  vga.println(vga.GetDisplayHeight());

  vga.print("BRAM memory:                      ");
  vga.print(vga.GetBRAMSize());
  vga.println(" KB");
  
  vga.print("BRAM read register interface:     ");
  vga.println(vga.IsBRAMRegisterReadConfigured() ? "Yes" : "No");

  vga.print("Text Generation:                  ");
  vga.println(vga.IsTextConfigured() ? "Yes" : "No");

  if (vga.IsTextConfigured())
  {
	vga.print("Text Color Attribute Byte:        ");
	vga.println(!vga.IsMonochromeConfigured() ? "Yes" : "No");

	vga.print("Text screen size:                 ");
	vga.print(vga.GetTextDisplayWidth());
	vga.print("x");
	vga.println(vga.GetTextDisplayHeight());

	vga.print("Text Address:                     0x");
	vga.PrintHex((uint32_t)vga.GetTextAddress());
	vga.println("");

	vga.print("Font:                             ");
	vga.print(vga.GetFontWidth());
	vga.print("x");
	vga.print(vga.GetFontHeight());
	vga.print(" ");
	vga.print(vga.GetFontCharacters());
	vga.print(" chars (");
	vga.print((vga.GetFontHeight() * vga.GetFontCharacters())/1024);
	vga.println(" KB)");

	vga.print("Font Address:                     0x");
	vga.PrintHex((uint32_t)vga.GetFontAddress());
	vga.println("");

	vga.print("Font cell height                  ");
	vga.println((uint32_t)VGAText_GetTextCellHeight());

	vga.print("Cursor Generation:                ");
	vga.println(vga.IsCursorConfigured() ? "Yes" : "No");

	vga.print("Cursor Blink Generation:          ");
	vga.println(vga.IsCursorBlinkConfigured() ? "Yes" : "No");
  }
  vga.print("16 Color Palette:                 ");
  vga.println(vga.IsPaletteConfigured() ? "Yes" : "No");

  vga.print("Bitmap Generation:                ");
  vga.println(vga.IsBitmapConfigured() ? "Yes" : "No");

  if (vga.IsBitmapConfigured())
  {
    Serial.print("Bitmap Address:                   0x");
    Serial.println((uint32_t)vga.GetBitmapAddress(), HEX);
    vga.print("Bitmap Address:                   0x");
    vga.PrintHex((uint32_t)vga.GetBitmapAddress());
    vga.println("");
  }

  
  bool kbd = keyboard.begin();
//  vga.println(kbd ? "Keyboard Test" : "No Keyboard");

  vga.SetColor(0x17);
  vga.print("Hi Davor!  ");
  vga.SetColor(0x19);
  vga.print("Xark");
  vga.SetColor(0x17);
  vga.println(" here.");
  vga.SetColor(0x1F);
  vga.print("This is VGA_textmode 640x480 HDMI running on the fabulous f32c!");
  vga.SetColor(0x14);
  vga.println(" :-)");
  vga.SetColor(0x1A);
  vga.println("Bitmap mode with FIFO achieved! :-)");
  vga.SetColor(0x1F);
  vga.println("2, 4 or 16-color with optional palette and 8-bit (RRRGGGBB) achieved! :-)");
  vga.SetColor(0x1e);
  vga.println("Text+color with FIFO achieved (with help from Davor)! :-)");

  vga.SetColor(0x00);
  vga.SetPos(7, 26);
  vga.print("                                                                  ");
  vga.SetPos(7, 27);
  vga.print("                                                                  ");
  vga.SetPos(7, 28);
  vga.print("                                                                  ");
  vga.SetPos(28, 29);
  vga.SetColor(0x1f);
  vga.print("256 direct-color RRRGGGBB");

  if (vga.IsBitmapConfigured())
  {
	  vga.SetBitmapAddress(fb);
	  vga.SetBitmapColor(0x108010);
	  vga.EnableBitmap();
	  drawRLE();
	  for (int x = 0; x < 256; x++)
	  {
		for (int y = 0; y < 8; y++)
		{
		  plot(64+(x*2), 424+y, (x&0xfc));
		  plot(65+(x*2), 424+y, (x&0xfc));

		  plot(64+(x*2), 432+y, (x&0xfc)|1);
		  plot(65+(x*2), 432+y, (x&0xfc)|1);
		
		  plot(64+(x*2), 440+y, (x&0xfc)|2);
		  plot(65+(x*2), 440+y, (x&0xfc)|2);

		  plot(64+(x*2), 448+y, (x&0xfc)|3);
		  plot(65+(x*2), 448+y, (x&0xfc)|3);
		}
    }
  }
}

uint32_t cnt;
void loop() {

//  vga.print("Woo-hoo foo-bar and a high-kittie-ditty-ho! ");
  // put your main code here, to run repeatedly:
  if (keyboard.available()) {
    
    // read the next key
    int c = keyboard.read();	
    
    // check for some of the special keys
    if (c == PS2_ENTER) {
      vga.println();
    } else if (c == PS2_TAB) {
      vga.print("[Tab]");
    } else if (c == PS2_ESC) {
      vga.print("[ESC]");
    } else if (c == PS2_PAGEDOWN) {
      vga.print("[PgDn]");
    } else if (c == PS2_PAGEUP) {
      vga.print("[PgUp]");
    } else if (c == PS2_LEFTARROW) {
      vga.print("[Left]");
    } else if (c == PS2_RIGHTARROW) {
      vga.print("[Right]");
    } else if (c == PS2_UPARROW) {
      vga.print("[Up]");
    } else if (c == PS2_DOWNARROW) {
      vga.print("[Down]");
    } else if (c == PS2_DELETE) {
      vga.print("[Del]");
    } else if (c == PS2_INSERT) {
      vga.print("[Insert]");
    } else if (c == PS2_HOME) {
      vga.print("[Home]");
    } else if (c == PS2_END) {
      vga.print("[End]");
//    } else if (c == PS2_BACKSPACE) {
//      vga.print("[Backspace]");
    } else if (c == PS2_F1) {
      vga.print("[F1]");
    } else if (c == PS2_F2) {
      vga.print("[F2]");
    } else if (c == PS2_F3) {
      vga.print("[F3]");
    } else if (c == PS2_F4) {
      vga.print("[F4]");
    } else if (c == PS2_F5) {
      vga.print("[F5]");
    } else if (c == PS2_F6) {
      vga.print("[F6]");
    } else if (c == PS2_F7) {
      vga.print("[F7]");
    } else if (c == PS2_F8) {
      vga.print("[F8]");
    } else if (c == PS2_F9) {
      vga.print("[F9]");
    } else if (c == PS2_F10) {
      vga.print("[F10]");
    } else if (c == PS2_F11) {
      vga.print("[F11]");
    } else if (c == PS2_F12) {
      vga.print("[F12]");
    } else if (c) {
      if (c < ' ')
	  {
		vga.print("[");
		vga.PrintHex((uint8_t)c);
		vga.print("]");
	  }
      // otherwise, just print all normal characters
      vga.print((char)c);
    }
  }
}


// Compressed RLE data
const uint8_t HaDLogo[] =
{
	0x00, 0x82, 0x81, 0x82, 0x7e, 0x02, 0x82, 0x7e, 0x02, 0x82, 0x7e, 0x02, 0x82, 0x7e, 0x02, 0x82, 
	0x7e, 0x02, 0x82, 0x7e, 0x02, 0x82, 0x7e, 0x02, 0x82, 0x7e, 0x02, 0x82, 0x7e, 0x02, 0x82, 0x7e, 
	0x02, 0x82, 0x7e, 0x02, 0x82, 0x7e, 0x02, 0x82, 0x7e, 0x02, 0x82, 0x7e, 0x02, 0x82, 0x7e, 0x02, 
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	0x7e, 0x02, 0x82, 0x7e, 0x02, 0x82, 0x7e, 0x02, 0x82, 0x7e, 0x82, 0x81, 
};

// Compressed RLE size 3900

void drawRLE()
{
	// pseudo-code for cheesy RLE
	// start with color1
	// while more input data remaining
	// 	count =  0nnnnnnn = 1 byte or 1nnnnnnn nnnnnnnn 2 bytes (0 - 32767)
	// 	repeat color count times
	// 	toggle color1/color2
	
	uint32_t	cnt = 0;
	int			color = 1;
	int			curcolor = 0;
	int			x = 0, y = 0;

	const uint8_t *cmp = &HaDLogo[0];

	while (cmp < &HaDLogo[sizeof(HaDLogo)])
	{
		cnt = *cmp++;
		if (cnt & 0x80)
			cnt = ((cnt & 0x7f) << 8) | *cmp++;

		while (cnt--)
		{
			plot(x, y, curcolor ? (((x>>1)+(y))) & 0xff : 0x00);
				
			if (++x >= 640)
			{
				x = 0;
				if (++y >= 480)
					y = 0;
			}
		}

		curcolor ^= color;
	}
}
